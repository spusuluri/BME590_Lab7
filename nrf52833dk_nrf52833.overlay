// To get started, press Ctrl+Space (or Option+Esc) to bring up the completion menu and view the available nodes.

// You can also use the buttons in the sidebar to perform actions on nodes.
// Actions currently available include:

// * Enabling / disabling the node
// * Adding the bus to a bus
// * Removing the node
// * Connecting ADC channels

// For more help, browse the DeviceTree documentation at https://docs.zephyrproject.org/latest/guides/dts/index.html
// You can also visit the nRF DeviceTree extension documentation at https://nrfconnect.github.io/vscode-nrf-connect/devicetree/nrfdevicetree.html

/ {
    aliases {
        //This is number 2
        heartbeat: &led0; //P0.13
        buzzer: &led1; //P0.14
        ivdrip: &led2; //P0.15
        alarm: &led3; //P0.16
        error: &led4; //P1.3
        //Number 3 of Assignment
        button0: &button0; //P0.11
        button1: &button1; //P0.12
        button2: &button2; //P0.24
        button3: &button3; //P0.25
    };
};

&gpio1 {
    compatible = "gpio-leds";
    led4: led_4{
        gpios = < &gpio1 3 GPIO_ACTIVE_LOW >;
        label = "ERROR LED";
    };
};
